## project-spec/configs/configs/Kconfig
```kconfig
mainmenu "PetaLinux System Configuration"
config SUBSYSTEM_TYPE_LINUX
        bool
        default y
        select SYSTEM_ZYNQ

config SYSTEM_ZYNQ
        bool "ZYNQ Configuration"
        help
          ZYNQ Configuration for petalinux project.
          All these config options will be in /home/rk/petalinux-2024.2/LCR_Board/zc702_project/project-spec/configs/config

config SUBSYSTEM_DISTRO_PETALINUX
        bool
        default y
        help

source /home/rk/petalinux-2024.2/LCR_Board/zc702_project/project-spec/configs/configs/Kconfig.main
```
